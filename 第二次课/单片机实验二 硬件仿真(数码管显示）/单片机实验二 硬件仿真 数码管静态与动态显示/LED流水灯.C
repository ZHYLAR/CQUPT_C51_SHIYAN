/*******************************************************************************
*                 
*                 		       普中科技
--------------------------------------------------------------------------------
* 实 验 名		 : LED二进制加法显示实验
* 实验说明       : LED灯做右移跑马灯
* 连接方式       : 见接线图
* 注    意		 : 
*******************************************************************************/

//--包含你要使用的头文件
#include <reg51.h>
#include <intrins.h>

//--声明全局函数--//
void Delay10ms(unsigned int c);   //延时10ms
/*******************************************************************************
* 函 数 名         : main
* 函数功能		   : 主函数
* 输    入         : 无
* 输    出         : 无
*******************************************************************************/
void main(void)
{
	unsigned char LED;

	LED = 0xFE;

	while(1)
	{
		P0 = LED;

		Delay10ms(50);

		LED = _crol_(LED,1);  //循环右移1位，点亮下一个LED  此函数于库函数
	}
}

/*******************************************************************************
* 函 数 名         : Delay10ms
* 函数功能		   : 延时函数，延时10ms
* 输    入         : 无
* 输    出         : 无
*******************************************************************************/

void Delay10ms(unsigned int c)   //误差 0us
{
    unsigned char a, b;

	//--c已经在传递过来的时候已经赋值了，所以在for语句第一句就不用赋值了--//
    for (;c>0;c--)
	{
		for (b=38;b>0;b--)
		{
			for (a=130;a>0;a--);
		}         
	}
}
