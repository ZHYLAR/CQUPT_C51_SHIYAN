//#include <REGX51.H>
#include <reg52.h>
sbit LED0 = P2^0;  // ??LED0?????
sbit LED7 = P2^7;  // ??LED7?????
unsigned int cnt0 = 0;
unsigned int cnt7 = 0;

void timer0_ISR() interrupt 1 {
    cnt0++;
    cnt7++;

    if (cnt0 == 2500*2) {  // LED0??1???
        cnt0 = 0;
        LED0 = ~LED0;
    }

    if (cnt7 == 12500*2) {  // LED7??5???
        cnt7 = 0;
        LED7 = ~LED7;
    }
		TL0 = 0x38;
}

void main() {
	  LED0 = 0;
		LED7 = 0;
		TMOD = 0x03;  // ?????T0?????3
    //TH0 = 0xFC;   // ???????,??1ms
    TL0 = 0x38;
    ET0 = 1;      // ?????T0?????
    TR0 = 1;      // ?????T0
    EA = 1;       // ?????
    while(1) {
        // ????????????
    }
}
