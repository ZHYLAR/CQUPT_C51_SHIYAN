/*******************************************************************************
*  标题:                  试验定时中断1使 蜂铃器发声(C语言)                    *
*																			   *
*  连接方法：参照接线图                                                 *
********************************************************************************
*                         	       										       *
* 请学员认真消化本例程，熟练定时中断1的编程                                    *
********************************************************************************/ 

#include < reg51.h >
#include <intrins.h>
int OneS = 0;
int flag=0;
sbit Beep = P1^5; 
unsigned int USE_C ; 

void Delay1ms(int m)		//@11.0592MHz
{
	for(;m<0;m--)
	{
	unsigned char i, j;

	_nop_();
	_nop_();
	_nop_();
	i = 11;
	j = 190;
	do
	{
		while (--j);
	} while (--i);
}
}


  
/*********************************************************
  主函数
**********************************************************/
void  main()
{
    TMOD=0x11;   //定时/计数器1工作于方式1
		TH0=(65536-10000)/256;
	  TL0=(65536-10000)%256;
    TH1=(65536-921)/256;	 //定时器初始值
    TL1=(65536-921)%256;    //50ms定时常数
    EA=1;        //开总中断
    ET1=1;       //允许定时/计数器1 中断
    TR1=1;       //启动定时/计数器1 中断
		ET0=1;       //允许定时/计数器1 中断
    TR0=1;
	  //Beep = ~Beep;
    while(1);
} 


/*********************************************************
  中断服务函数
**********************************************************/
void Time1(void) interrupt 3  //using 0
{
	 if(!OneS){
   Beep = ~Beep;
   TH1=(65536-921)/256;
   TL1=(65536-921)%256;
}
	 }
/*********************************************************/
void delay(void) interrupt 1
{
   flag++;
	 if(flag==100)
		 OneS = 1;
TH0=(65536-10000)/256;
	  TL0=(65536-10000)%256;
}

